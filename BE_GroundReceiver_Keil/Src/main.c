/* USER CODE BEGIN Header */
/**
  ******************************************************************************
  * @file           : main.c
  * @brief          : Main program body
  ******************************************************************************
  * @attention
  *
  * <h2><center>&copy; Copyright (c) 2022 STMicroelectronics.
  * All rights reserved.</center></h2>
  *
  * This software component is licensed by ST under BSD 3-Clause license,
  * the "License"; You may not use this file except in compliance with the
  * License. You may obtain a copy of the License at:
  *                        opensource.org/licenses/BSD-3-Clause
  *
  ******************************************************************************
  */
/* USER CODE END Header */
/* Includes ------------------------------------------------------------------*/
#include "main.h"

/* Private includes ----------------------------------------------------------*/
/* USER CODE BEGIN Includes */
#include <stdio.h>
#include <string.h>
#include <stdlib.h>
#include <stdbool.h>



/* USER CODE END Includes */

/* Private typedef -----------------------------------------------------------*/
/* USER CODE BEGIN PTD */

/* USER CODE END PTD */

/* Private define ------------------------------------------------------------*/
/* USER CODE BEGIN PD */



#define CSX_PORT GPIOB
#define CSX_PIN GPIO_PIN_10

#define DC_PORT GPIOB
#define DC_PIN GPIO_PIN_0

#define RESET_PORT GPIOB
#define RESET_PIN GPIO_PIN_1


#define LCD_REST_LOW()   HAL_GPIO_WritePin(RESET_PORT, RESET_PIN, 0)
#define LCD_REST_HIGH()  HAL_GPIO_WritePin(RESET_PORT, RESET_PIN, 1)

#define LCD_DC_LOW()     HAL_GPIO_WritePin(DC_PORT, DC_PIN, 0)
#define LCD_DC_HIGH()    HAL_GPIO_WritePin(DC_PORT, DC_PIN, 1)

#define LCD_CS_LOW()     HAL_GPIO_WritePin(CSX_PORT, CSX_PIN, 0)
#define LCD_CS_HIGH()    HAL_GPIO_WritePin(CSX_PORT, CSX_PIN, 1)

const unsigned char ascii_3216[][64]={
{0x00,0x00,0x00,0x00,0x00,0x00,0x00,0x00,0x00,0x00,0x00,0x00,0x00,0x00,0x00,0x00,0x00,0x00,0x00,0x00,0x00,0x00,0x00,0x00,0x00,0x00,0x00,0x00,0x00,0x00,0x00,0x00,0x00,0x00,0x00,0x00,0x00,0x00,0x00,0x00,0x00,0x00,0x00,0x00,0x00,0x00,0x00,0x00,0x00,0x00,0x00,0x00,0x00,0x00,0x00,0x00,0x00,0x00,0x00,0x00,0x00,0x00,0x00,0x00},/*" ",0*/
{0x00,0x00,0x00,0x00,0x00,0x00,0x00,0x00,0x00,0x00,0xC0,0x01,0xC0,0x01,0xC0,0x01,0xC0,0x01,0xC0,0x01,0xC0,0x01,0xC0,0x01,0x80,0x00,0x80,0x00,0x80,0x00,0x80,0x00,0x80,0x00,0x80,0x00,0x80,0x00,0x00,0x00,0x00,0x00,0x00,0x00,0x00,0x00,0x80,0x01,0xC0,0x03,0xC0,0x03,0x80,0x01,0x00,0x00,0x00,0x00,0x00,0x00,0x00,0x00,0x00,0x00},/*"!",1*/
{0x00,0x00,0x00,0x00,0x00,0x00,0xE0,0x1C,0xE0,0x1C,0xF0,0x1E,0x70,0x0E,0x38,0x07,0x18,0x03,0x08,0x01,0x84,0x00,0x00,0x00,0x00,0x00,0x00,0x00,0x00,0x00,0x00,0x00,0x00,0x00,0x00,0x00,0x00,0x00,0x00,0x00,0x00,0x00,0x00,0x00,0x00,0x00,0x00,0x00,0x00,0x00,0x00,0x00,0x00,0x00,0x00,0x00,0x00,0x00,0x00,0x00,0x00,0x00,0x00,0x00},/*""",2*/
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{0x00,0x00,0x38,0x00,0xC4,0x00,0x86,0x40,0x02,0x61,0x00,0x22,0x00,0x1C,0x00,0x00,0x00,0x00,0x00,0x00,0x00,0x00,0x00,0x00,0x00,0x00,0x00,0x00,0x00,0x00,0x00,0x00,0x00,0x00,0x00,0x00,0x00,0x00,0x00,0x00,0x00,0x00,0x00,0x00,0x00,0x00,0x00,0x00,0x00,0x00,0x00,0x00,0x00,0x00,0x00,0x00,0x00,0x00,0x00,0x00,0x00,0x00,0x00,0x00},/*"~",94*/
};

/*
#define LCD_M0()     HAL_GPIO_WritePin(GPIOB, GPIO_PIN_7, 0)
#define LCD_M1()    HAL_GPIO_WritePin(GPIOB, GPIO_PIN_8, 1)
#define LCD_M2()    HAL_GPIO_WritePin(GPIOB, GPIO_PIN_9, 1)*/
/* USER CODE END PD */

/* Private macro -------------------------------------------------------------*/
/* USER CODE BEGIN PM */

/* USER CODE END PM */

/* Private variables ---------------------------------------------------------*/
RTC_HandleTypeDef hrtc;

SPI_HandleTypeDef hspi1;

TIM_HandleTypeDef htim1;

UART_HandleTypeDef huart1;

/* USER CODE BEGIN PV */

RTC_TimeTypeDef sTime;
RTC_DateTypeDef DateToUpdate;
char UTC_TIME[3];
char UTC_DATE[3];
char HOURS[20],H[20];
char MINUTES[20],MIN[20];
char SECONDS[20],S[20];
char YEAR[20],Y[20];
char MONTHS[20],MON[20];
char DATE[20],D[20];
char sensor[20];
uint8_t Rx_indx = 0;
uint8_t Rx_data = 0;
uint8_t RX_BUFFER[7];
uint8_t TX_BUFFER;
bool toggleF=true;
uint8_t mode=88;
uint8_t check=0;
bool timeupdating=0;
uint8_t timecounting=0;



/* USER CODE END PV */

/* Private function prototypes -----------------------------------------------*/
void SystemClock_Config(void);
static void MX_GPIO_Init(void);
static void MX_SPI1_Init(void);
static void MX_RTC_Init(void);
static void MX_TIM1_Init(void);
static void MX_USART1_UART_Init(void);
/* USER CODE BEGIN PFP */
void LCD_Init(void);
void LCD_WriteSPI(uint8_t data);
void LCD_WriteCommand(uint8_t data);
void LCD_WriteData(uint8_t data);
void LCD_Address_Set(uint16_t x1,uint16_t y1,uint16_t x2,uint16_t y2);
void LCD_Fill(uint16_t xsta,uint16_t ysta,uint16_t xend,uint16_t yend,uint16_t color);
void LCD_DrawLine(uint16_t x1,uint16_t y1,uint16_t x2,uint16_t y2,uint16_t color);
void LCD_DrawPoint(uint16_t x,uint16_t y,uint16_t color);
void LCD_ShowChar(uint16_t x,uint16_t y,uint8_t num,uint16_t fc);
void LCD_ShowString(uint16_t x,uint16_t y,const char*p,uint16_t fc);
void display_format();
void VerticalProfileCheck();
void display_teamname();
//void askforreset();


/* USER CODE END PFP */

/* Private user code ---------------------------------------------------------*/
/* USER CODE BEGIN 0 */

/* USER CODE END 0 */

/**
  * @brief  The application entry point.
  * @retval int
  */
int main(void)
{
  /* USER CODE BEGIN 1 */

	
	
  /* USER CODE END 1 */

  /* MCU Configuration--------------------------------------------------------*/

  /* Reset of all peripherals, Initializes the Flash interface and the Systick. */
  HAL_Init();

  /* USER CODE BEGIN Init */
  /* USER CODE END Init */

  /* Configure the system clock */
  SystemClock_Config();

  /* USER CODE BEGIN SysInit */

  /* USER CODE END SysInit */

  /* Initialize all configured peripherals */
  MX_GPIO_Init();
  MX_SPI1_Init();
  MX_RTC_Init();
  MX_TIM1_Init();
  MX_USART1_UART_Init();
  /* USER CODE BEGIN 2 */
	LCD_Init();
	LCD_Fill(0,0,320,240,0x0000);
	display_format();
	VerticalProfileCheck();
	HAL_UART_Receive_IT(&huart1, &Rx_data, 1);

	
	


	//HAL_UART_Receive_IT(&huart1, &Rx_data, 1);
	//VerticalProfileCheck();

  /* USER CODE END 2 */

  /* Infinite loop */
  /* USER CODE BEGIN WHILE */
  while (1)
  {
    /* USER CODE END WHILE */

    /* USER CODE BEGIN 3 */
		//HAL_UART_Receive_IT(&huart1, &Rx_data, 1);
		
		if(mode==88&&!HAL_GPIO_ReadPin(GPIOA, GPIO_PIN_8)){
			mode=77;
			VerticalProfileCheck();
			TX_BUFFER=77;
			HAL_UART_Transmit(&huart1, &TX_BUFFER, 1, 100);
		}
		if(mode==77&&!HAL_GPIO_ReadPin(GPIOA, GPIO_PIN_8)){
			mode=66;
			VerticalProfileCheck();
			TX_BUFFER=66;
			HAL_UART_Transmit(&huart1, &TX_BUFFER, 1, 100);
		}
		if(mode==66&&!HAL_GPIO_ReadPin(GPIOA, GPIO_PIN_8)){
			mode=80;
			TX_BUFFER=80;
			HAL_UART_Transmit(&huart1, &TX_BUFFER, 1, 100);
			VerticalProfileCheck();
		}
		if(mode==80&&!HAL_GPIO_ReadPin(GPIOA, GPIO_PIN_8)){
			mode=88;
			TX_BUFFER=88;
			HAL_UART_Transmit(&huart1, &TX_BUFFER, 1, 100);
			VerticalProfileCheck();
		}
		
//		if(!HAL_GPIO_ReadPin(GPIOA, GPIO_PIN_7)){
//				mode=88;
//				TX_BUFFER=88;
//				HAL_UART_Transmit(&huart1, &TX_BUFFER, 1, 100);
//				VerticalProfileCheck();
//			
//		}
 			
		sprintf((char*)H,"%02d",RX_BUFFER[0]); //strncpy(HOURS, H, 20);
		sprintf((char*)MIN,"%02d",RX_BUFFER[1]); //strncpy(MINUTES, MIN, 20);
		sprintf((char*)S,"%02d",RX_BUFFER[2]); //strncpy(SECONDS, S, 20);
		sprintf((char*)Y,"%02d",RX_BUFFER[3]+2000); //strncpy(YEAR, Y, 20);
		sprintf((char*)MON,"%02d",RX_BUFFER[4]); //st rncpy(MONTHS, MON, 20);
		sprintf((char*)D,"%02d",RX_BUFFER[5]); //strncpy(DATE, D, 20);
		
		//sprintf((char*)sensor,"%02d",RX_BUFFER[7]); //strncpy(DATE, D, 20);

		if(strcmp(HOURS, H) != 0 ){
			LCD_ShowString(96,136,HOURS,0x0000);//HOURS
			strncpy(HOURS, H, 20);
			LCD_ShowString(96,136,HOURS,0xFFFF);//HOURS
			
		}
		if(strcmp(MINUTES, MIN) != 0 ){
			LCD_ShowString(144,136,MINUTES,0x0000);//MINUTES
			strncpy(MINUTES, MIN, 20);
			LCD_ShowString(144,136,MINUTES,0xFFFF);//MINUTES
			
		}
		if(strcmp(SECONDS, S) != 0 ){
			LCD_ShowString(192,136,SECONDS,0x0000);//SECONDS
			strncpy(SECONDS, S, 20);
			LCD_ShowString(192,136,SECONDS,0xFFFF);//SECONDS
			//display_teamname();
			
			if(mode==77){
				timecounting++;
				if(timecounting==15)
				display_teamname();
			}
			
		}
		
		if(strcmp(YEAR, Y) != 0 ){
			LCD_ShowString(80,170,YEAR,0x0000);//YEAR
			strncpy(YEAR, Y, 20);
			LCD_ShowString(80,170,YEAR,0xFFFF);//YEAR
			
		}
		if(strcmp(MONTHS, MON) != 0 ){
			LCD_ShowString(160,170,MONTHS,0x0000);//MONTHS
			strncpy(MONTHS, MON, 20);
			LCD_ShowString(160,170,MONTHS,0xFFFF);//MONTHS
			
		}if(strcmp(DATE, D) != 0 ){
			LCD_ShowString(208,170,DATE,0x0000);//DATE
			strncpy(DATE, D, 20);
			LCD_ShowString(208,170,DATE,0xFFFF);//DATE
			
		}
		HAL_Delay(100);

  }
  /* USER CODE END 3 */
}

/**
  * @brief System Clock Configuration
  * @retval None
  */
void SystemClock_Config(void)
{
  RCC_OscInitTypeDef RCC_OscInitStruct = {0};
  RCC_ClkInitTypeDef RCC_ClkInitStruct = {0};
  RCC_PeriphCLKInitTypeDef PeriphClkInit = {0};

  /** Initializes the RCC Oscillators according to the specified parameters
  * in the RCC_OscInitTypeDef structure.
  */
  RCC_OscInitStruct.OscillatorType = RCC_OSCILLATORTYPE_HSE;
  RCC_OscInitStruct.HSEState = RCC_HSE_ON;
  RCC_OscInitStruct.HSEPredivValue = RCC_HSE_PREDIV_DIV1;
  RCC_OscInitStruct.HSIState = RCC_HSI_ON;
  RCC_OscInitStruct.PLL.PLLState = RCC_PLL_ON;
  RCC_OscInitStruct.PLL.PLLSource = RCC_PLLSOURCE_HSE;
  RCC_OscInitStruct.PLL.PLLMUL = RCC_PLL_MUL9;
  if (HAL_RCC_OscConfig(&RCC_OscInitStruct) != HAL_OK)
  {
    Error_Handler();
  }

  /** Initializes the CPU, AHB and APB buses clocks
  */
  RCC_ClkInitStruct.ClockType = RCC_CLOCKTYPE_HCLK|RCC_CLOCKTYPE_SYSCLK
                              |RCC_CLOCKTYPE_PCLK1|RCC_CLOCKTYPE_PCLK2;
  RCC_ClkInitStruct.SYSCLKSource = RCC_SYSCLKSOURCE_PLLCLK;
  RCC_ClkInitStruct.AHBCLKDivider = RCC_SYSCLK_DIV1;
  RCC_ClkInitStruct.APB1CLKDivider = RCC_HCLK_DIV2;
  RCC_ClkInitStruct.APB2CLKDivider = RCC_HCLK_DIV1;

  if (HAL_RCC_ClockConfig(&RCC_ClkInitStruct, FLASH_LATENCY_2) != HAL_OK)
  {
    Error_Handler();
  }
  PeriphClkInit.PeriphClockSelection = RCC_PERIPHCLK_RTC;
  PeriphClkInit.RTCClockSelection = RCC_RTCCLKSOURCE_HSE_DIV128;
  if (HAL_RCCEx_PeriphCLKConfig(&PeriphClkInit) != HAL_OK)
  {
    Error_Handler();
  }
}

/**
  * @brief RTC Initialization Function
  * @param None
  * @retval None
  */
static void MX_RTC_Init(void)
{

  /* USER CODE BEGIN RTC_Init 0 */

  /* USER CODE END RTC_Init 0 */

  RTC_TimeTypeDef sTime = {0};
  RTC_DateTypeDef DateToUpdate = {0};

  /* USER CODE BEGIN RTC_Init 1 */

  /* USER CODE END RTC_Init 1 */

  /** Initialize RTC Only
  */
  hrtc.Instance = RTC;
  hrtc.Init.AsynchPrediv = RTC_AUTO_1_SECOND;
  hrtc.Init.OutPut = RTC_OUTPUTSOURCE_ALARM;
  if (HAL_RTC_Init(&hrtc) != HAL_OK)
  {
    Error_Handler();
  }

  /* USER CODE BEGIN Check_RTC_BKUP */

  /* USER CODE END Check_RTC_BKUP */

  /** Initialize RTC and set the Time and Date
  */
  sTime.Hours = 11;
  sTime.Minutes = 47;
  sTime.Seconds = 0;

  if (HAL_RTC_SetTime(&hrtc, &sTime, RTC_FORMAT_BIN) != HAL_OK)
  {
    Error_Handler();
  }
  DateToUpdate.WeekDay = RTC_WEEKDAY_SUNDAY;
  DateToUpdate.Month = RTC_MONTH_JANUARY;
  DateToUpdate.Date = 15;
  DateToUpdate.Year = 23;

  if (HAL_RTC_SetDate(&hrtc, &DateToUpdate, RTC_FORMAT_BIN) != HAL_OK)
  {
    Error_Handler();
  }
  /* USER CODE BEGIN RTC_Init 2 */

  /* USER CODE END RTC_Init 2 */

}

/**
  * @brief SPI1 Initialization Function
  * @param None
  * @retval None
  */
static void MX_SPI1_Init(void)
{

  /* USER CODE BEGIN SPI1_Init 0 */

  /* USER CODE END SPI1_Init 0 */

  /* USER CODE BEGIN SPI1_Init 1 */

  /* USER CODE END SPI1_Init 1 */
  /* SPI1 parameter configuration*/
  hspi1.Instance = SPI1;
  hspi1.Init.Mode = SPI_MODE_MASTER;
  hspi1.Init.Direction = SPI_DIRECTION_2LINES;
  hspi1.Init.DataSize = SPI_DATASIZE_8BIT;
  hspi1.Init.CLKPolarity = SPI_POLARITY_LOW;
  hspi1.Init.CLKPhase = SPI_PHASE_1EDGE;
  hspi1.Init.NSS = SPI_NSS_SOFT;
  hspi1.Init.BaudRatePrescaler = SPI_BAUDRATEPRESCALER_4;
  hspi1.Init.FirstBit = SPI_FIRSTBIT_MSB;
  hspi1.Init.TIMode = SPI_TIMODE_DISABLE;
  hspi1.Init.CRCCalculation = SPI_CRCCALCULATION_DISABLE;
  hspi1.Init.CRCPolynomial = 10;
  if (HAL_SPI_Init(&hspi1) != HAL_OK)
  {
    Error_Handler();
  }
  /* USER CODE BEGIN SPI1_Init 2 */

  /* USER CODE END SPI1_Init 2 */

}

/**
  * @brief TIM1 Initialization Function
  * @param None
  * @retval None
  */
static void MX_TIM1_Init(void)
{

  /* USER CODE BEGIN TIM1_Init 0 */

  /* USER CODE END TIM1_Init 0 */

  TIM_ClockConfigTypeDef sClockSourceConfig = {0};
  TIM_SlaveConfigTypeDef sSlaveConfig = {0};
  TIM_MasterConfigTypeDef sMasterConfig = {0};
  TIM_OC_InitTypeDef sConfigOC = {0};
  TIM_BreakDeadTimeConfigTypeDef sBreakDeadTimeConfig = {0};

  /* USER CODE BEGIN TIM1_Init 1 */

  /* USER CODE END TIM1_Init 1 */
  htim1.Instance = TIM1;
  htim1.Init.Prescaler = 0;
  htim1.Init.CounterMode = TIM_COUNTERMODE_UP;
  htim1.Init.Period = 65535;
  htim1.Init.ClockDivision = TIM_CLOCKDIVISION_DIV1;
  htim1.Init.RepetitionCounter = 0;
  htim1.Init.AutoReloadPreload = TIM_AUTORELOAD_PRELOAD_DISABLE;
  if (HAL_TIM_Base_Init(&htim1) != HAL_OK)
  {
    Error_Handler();
  }
  sClockSourceConfig.ClockSource = TIM_CLOCKSOURCE_INTERNAL;
  if (HAL_TIM_ConfigClockSource(&htim1, &sClockSourceConfig) != HAL_OK)
  {
    Error_Handler();
  }
  if (HAL_TIM_OC_Init(&htim1) != HAL_OK)
  {
    Error_Handler();
  }
  sSlaveConfig.SlaveMode = TIM_SLAVEMODE_DISABLE;
  sSlaveConfig.InputTrigger = TIM_TS_ITR1;
  if (HAL_TIM_SlaveConfigSynchro(&htim1, &sSlaveConfig) != HAL_OK)
  {
    Error_Handler();
  }
  sMasterConfig.MasterOutputTrigger = TIM_TRGO_RESET;
  sMasterConfig.MasterSlaveMode = TIM_MASTERSLAVEMODE_DISABLE;
  if (HAL_TIMEx_MasterConfigSynchronization(&htim1, &sMasterConfig) != HAL_OK)
  {
    Error_Handler();
  }
  sConfigOC.OCMode = TIM_OCMODE_TIMING;
  sConfigOC.Pulse = 0;
  sConfigOC.OCPolarity = TIM_OCPOLARITY_HIGH;
  sConfigOC.OCNPolarity = TIM_OCNPOLARITY_HIGH;
  sConfigOC.OCFastMode = TIM_OCFAST_DISABLE;
  sConfigOC.OCIdleState = TIM_OCIDLESTATE_RESET;
  sConfigOC.OCNIdleState = TIM_OCNIDLESTATE_RESET;
  if (HAL_TIM_OC_ConfigChannel(&htim1, &sConfigOC, TIM_CHANNEL_1) != HAL_OK)
  {
    Error_Handler();
  }
  sBreakDeadTimeConfig.OffStateRunMode = TIM_OSSR_DISABLE;
  sBreakDeadTimeConfig.OffStateIDLEMode = TIM_OSSI_DISABLE;
  sBreakDeadTimeConfig.LockLevel = TIM_LOCKLEVEL_OFF;
  sBreakDeadTimeConfig.DeadTime = 0;
  sBreakDeadTimeConfig.BreakState = TIM_BREAK_DISABLE;
  sBreakDeadTimeConfig.BreakPolarity = TIM_BREAKPOLARITY_HIGH;
  sBreakDeadTimeConfig.AutomaticOutput = TIM_AUTOMATICOUTPUT_DISABLE;
  if (HAL_TIMEx_ConfigBreakDeadTime(&htim1, &sBreakDeadTimeConfig) != HAL_OK)
  {
    Error_Handler();
  }
  /* USER CODE BEGIN TIM1_Init 2 */

  /* USER CODE END TIM1_Init 2 */

}

/**
  * @brief USART1 Initialization Function
  * @param None
  * @retval None
  */
static void MX_USART1_UART_Init(void)
{

  /* USER CODE BEGIN USART1_Init 0 */

  /* USER CODE END USART1_Init 0 */

  /* USER CODE BEGIN USART1_Init 1 */

  /* USER CODE END USART1_Init 1 */
  huart1.Instance = USART1;
  huart1.Init.BaudRate = 9600;
  huart1.Init.WordLength = UART_WORDLENGTH_8B;
  huart1.Init.StopBits = UART_STOPBITS_1;
  huart1.Init.Parity = UART_PARITY_NONE;
  huart1.Init.Mode = UART_MODE_TX_RX;
  huart1.Init.HwFlowCtl = UART_HWCONTROL_NONE;
  huart1.Init.OverSampling = UART_OVERSAMPLING_16;
  if (HAL_UART_Init(&huart1) != HAL_OK)
  {
    Error_Handler();
  }
  /* USER CODE BEGIN USART1_Init 2 */

  /* USER CODE END USART1_Init 2 */

}

/**
  * @brief GPIO Initialization Function
  * @param None
  * @retval None
  */
static void MX_GPIO_Init(void)
{
  GPIO_InitTypeDef GPIO_InitStruct = {0};

  /* GPIO Ports Clock Enable */
  __HAL_RCC_GPIOD_CLK_ENABLE();
  __HAL_RCC_GPIOA_CLK_ENABLE();
  __HAL_RCC_GPIOB_CLK_ENABLE();

  /*Configure GPIO pin Output Level */
  HAL_GPIO_WritePin(GPIOB, GPIO_PIN_0|GPIO_PIN_1|GPIO_PIN_2|GPIO_PIN_10
                          |GPIO_PIN_15, GPIO_PIN_RESET);

  /*Configure GPIO pins : PA7 PA8 */
  GPIO_InitStruct.Pin = GPIO_PIN_7|GPIO_PIN_8;
  GPIO_InitStruct.Mode = GPIO_MODE_INPUT;
  GPIO_InitStruct.Pull = GPIO_PULLUP;
  HAL_GPIO_Init(GPIOA, &GPIO_InitStruct);

  /*Configure GPIO pins : PB0 PB1 PB2 PB10
                           PB15 */
  GPIO_InitStruct.Pin = GPIO_PIN_0|GPIO_PIN_1|GPIO_PIN_2|GPIO_PIN_10
                          |GPIO_PIN_15;
  GPIO_InitStruct.Mode = GPIO_MODE_OUTPUT_PP;
  GPIO_InitStruct.Pull = GPIO_NOPULL;
  GPIO_InitStruct.Speed = GPIO_SPEED_FREQ_LOW;
  HAL_GPIO_Init(GPIOB, &GPIO_InitStruct);

}

/* USER CODE BEGIN 4 */
void HAL_UART_RxCpltCallback(UART_HandleTypeDef *huart)  
{
		//For UTC time
	
		if (huart->Instance==USART1) { // Current UART
			RX_BUFFER[Rx_indx++] = Rx_data;    // Add data to Rx_Buffer	
   }
	 if(Rx_indx!=7&&Rx_data==0xff){Rx_indx=0;}
	 if(Rx_indx==7){Rx_indx=0;} 
	 HAL_UART_Receive_IT(&huart1, &Rx_data, 1);
	
}

void LCD_Init(void){
	
	LCD_CS_HIGH();
	HAL_Delay(10);
	LCD_CS_LOW();//the serial interface is initialized when CSX is high. P56
								// SCL and SDA no effect

	LCD_REST_LOW();
	//HAL_Delay(1000);
	LCD_REST_HIGH();
	//HAL_Delay(10000);
	
	LCD_CS_HIGH();
	LCD_WriteCommand(0x01); //software reset
	//LCD_WriteCommand(0x28); //DISPLAY OFF
	LCD_WriteCommand(0x11); //sleep out
	HAL_Delay(10); 
	
	//LCD_M0();
	//LCD_M1();
	//LCD_M2();
	
	LCD_WriteCommand(0x36); //Memory Data Access Control
	LCD_WriteData(0x40);
	

	LCD_WriteCommand(0x3A);//Interface Pixel Format 
	LCD_WriteData(0x05); //?101? = 16bit/pixel 

	LCD_WriteCommand(0xB2);//Porch Setting
	LCD_WriteData(0x0C);
	LCD_WriteData(0x0C);
	LCD_WriteData(0x00);
	LCD_WriteData(0x33);
	LCD_WriteData(0x33); 

	LCD_WriteCommand(0xB7); //Gate Control
	LCD_WriteData(0x35);  

	LCD_WriteCommand(0xBB);//VCOM Setting
	LCD_WriteData(0x35);

	LCD_WriteCommand(0xC0);//LCM Control .
	LCD_WriteData(0x2C);

	LCD_WriteCommand(0xC2);//VDV and VRH Command Enable
	LCD_WriteData(0x01);
	LCD_WriteData(0xFF);

	LCD_WriteCommand(0xC3);//VRH Set
	LCD_WriteData(0x13);   

	LCD_WriteCommand(0xC4);//VDV Set
	LCD_WriteData(0x20);  

	LCD_WriteCommand(0xC6); // Frame Rate Control in Normal Mode
	LCD_WriteData(0x0F);    

	LCD_WriteCommand(0xD0); //Power Control 1 
	LCD_WriteData(0xA4);
	LCD_WriteData(0xA1);


	LCD_WriteCommand(0xE0);
  LCD_WriteData(0xF0);
  LCD_WriteData(0x00);
  LCD_WriteData(0x04);
  LCD_WriteData(0x04);
  LCD_WriteData(0x04);
  LCD_WriteData(0x05);
  LCD_WriteData(0x29);
  LCD_WriteData(0x33);
  LCD_WriteData(0x3E);
  LCD_WriteData(0x38);
  LCD_WriteData(0x12);
  LCD_WriteData(0x12);
  LCD_WriteData(0x28);
  LCD_WriteData(0x30);

	LCD_WriteCommand(0xE1);
	LCD_WriteData(0xF0);
  LCD_WriteData(0x07);
  LCD_WriteData(0x0A);
  LCD_WriteData(0x0D);
  LCD_WriteData(0x0B);
  LCD_WriteData(0x07);
  LCD_WriteData(0x28);
  LCD_WriteData(0x33);
  LCD_WriteData(0x3E);
  LCD_WriteData(0x36);
  LCD_WriteData(0x14);
  LCD_WriteData(0x14);
  LCD_WriteData(0x29);
  LCD_WriteData(0x32);
	
	//LCD_WriteCommand(0x21); //Display Inversion On
  
  LCD_WriteCommand(0x11); //Sleep out	
	LCD_WriteCommand(0x13); //Nomal diaplay on
	LCD_WriteCommand(0x38); //idle off
	LCD_WriteCommand(0x29);//:Display On
	
	//LCD_WriteCommand(0x51);//Write Display Brightness
	//LCD_WriteData(0x00);
	
}

void LCD_WriteSPI(uint8_t data){
	HAL_SPI_Transmit(&hspi1, &data, 1, 0xffff);
}


void LCD_WriteCommand(uint8_t data){
	LCD_CS_LOW();
	LCD_DC_LOW();
	LCD_WriteSPI(data);
	LCD_DC_HIGH();
	LCD_CS_HIGH();
}

void LCD_WriteData(uint8_t data){
	LCD_CS_LOW();
	LCD_DC_HIGH();
	LCD_WriteSPI(data);
	LCD_DC_LOW();
	LCD_CS_HIGH();
}


void LCD_Address_Set(uint16_t x1,uint16_t y1,uint16_t x2,uint16_t y2){
	
	LCD_WriteCommand(0x2b);	//row 

	LCD_WriteData(x1>>8);
	LCD_WriteData(x1);
	LCD_WriteData(x2>>8);
	LCD_WriteData(x2);
	

	LCD_WriteCommand(0x2a);	//col
	LCD_WriteData(y1>>8);
	LCD_WriteData(y1);
	LCD_WriteData(y2>>8);
	LCD_WriteData(y2);
	
	LCD_WriteCommand(0x2c);	//Memory write
}
void LCD_Fill(uint16_t xsta,uint16_t ysta,uint16_t xend,uint16_t yend,uint16_t color)
{          
	uint16_t i,j; 
	LCD_Address_Set(xsta,ysta,xend-1,yend-1);
	for(i=xsta;i<xend;i++)
	{													   	 	
		for(j=ysta;j<yend;j++)
		{
			LCD_WriteData(color);
			LCD_WriteData(color>>8);
		}
	} 					  	    
}

void LCD_DrawPoint(uint16_t x,uint16_t y,uint16_t color)
{
	LCD_Address_Set(x,y,x,y);
	LCD_WriteData(color);
	LCD_WriteData(color>>8);
} 

void LCD_DrawLine(uint16_t x1,uint16_t y1,uint16_t x2,uint16_t y2,uint16_t color)
{
	
	uint16_t i,j; 
	LCD_Address_Set(x1,y1,x2-1,y2-1);
	for(i=x1;i<x2;i++)
	{													   	 	
		for(j=y1;j<y2;j++)
		{
			LCD_WriteData(color);
			LCD_WriteData(color>>8);
		}
	}
	
}

void LCD_ShowChar(uint16_t x,uint16_t y,uint8_t num,uint16_t fc)
{
	uint8_t temp,sizex,t,sizey=32;
	uint16_t i,TypefaceNum;
	uint16_t x0=x;
	sizex=sizey/2;
	TypefaceNum=(sizex/8+((sizex%8)?1:0))*sizey;
	num=num-' ';    
	LCD_Address_Set(x,y,x+sizex-1,y+sizey-1); 

for(i=0;i<TypefaceNum;i++)
	{ 
		for(t=0;t<8;t++)
		{
				temp=ascii_3216[num][i];
				if(temp&(0x01<<t))
					LCD_DrawPoint(x,y,fc);
				x++;
				if((x-x0)==sizex)
				{
					x=x0;
					y++;
					break;
				}
			}
		}
}

void LCD_ShowString(uint16_t x,uint16_t y,const char *p,uint16_t fc)
{      
	
	while(*p!='\0')
	{       
		LCD_ShowChar(x,y,*p,fc);
		x+=32/2;
		p++;
	}  
}

/*
display: X x Y= 320x240
font size: x,y=32,16

pure letters(L) or numbers(N): total 20 Ls/Ns 
each line -> 34: 7 Rows

LCD_ShowString(0,0,"ABCDEFGHIJKLMNOPWRST",0x07E0);
LCD_ShowString(0,34,"0123456789abcdefghij",0x07E0);
*/
void display_format(){
	
	//FOR DISPLAY TIME
	LCD_ShowString(128,136,":",0xFFFF);
	LCD_ShowString(176,136,":",0xFFFF);
	//FOR DISPLAY DATE
	LCD_ShowString(144,170,"-",0xFFFF);
	LCD_ShowString(192,170,"-",0xFFFF);
	
	//DISPLAY TEAM NAME
	LCD_ShowString(80,68,"Team Name1",0xffff); //line3
	
	
}

void display_teamname(){
	//DISPLAY TEAM NAME
	LCD_Fill(0,68,320,102,0x0000);
	LCD_ShowString(128,68,"EX07",0xffff); //line3
	
	
}


void VerticalProfileCheck(){
		if(mode==99){
			LCD_Fill(0,0,320,68,0x0000);
			LCD_ShowString(0,0,"Device Disconnected",0xffff); //line3
		}
		if(mode==88){
			LCD_Fill(0,0,320,68,0x0000);
			LCD_ShowString(32,0,"Device is ready!",0xffff); //line3
		}
		
		if(mode==80){
			LCD_Fill(0,0,320,68,0x0000);
			LCD_ShowString(32,0,"Task Finished!!!",0xffff); //line3
		}
	if(mode==77){
			LCD_Fill(0,0,320,68,0x0000);
			LCD_ShowString(0,0,"1st Vertical Profile",0xffff); //line3
			//send and indicaet to run first profile
		
		}
	if(mode==66){
		LCD_Fill(0,0,320,68,0x0000);
		LCD_ShowString(0,0,"2nd Vertical Profile",0xffff); //line3
	
		//send and indicaet to run second profile
		}
	

}

//void askforreset(){

//	while(mode==99){
//		//LCD_Fill(0,0,320,68,0x2112);
//		LCD_ShowString(0,0,"Device Disconnected",0xffff); //line3
//		while(1){
//			TX_BUFFER=88;
//			HAL_UART_Transmit(&huart1, &TX_BUFFER, 1, 100);
//			if(Rx_data==88){
//				mode=88;
//				break;
//			}	
//		}
//	}
//	VerticalProfileCheck();

//}

/* USER CODE END 4 */

/**
  * @brief  This function is executed in case of error occurrence.
  * @retval None
  */
void Error_Handler(void)
{
  /* USER CODE BEGIN Error_Handler_Debug */
  /* User can add his own implementation to report the HAL error return state */

  /* USER CODE END Error_Handler_Debug */
}

#ifdef  USE_FULL_ASSERT
/**
  * @brief  Reports the name of the source file and the source line number
  *         where the assert_param error has occurred.
  * @param  file: pointer to the source file name
  * @param  line: assert_param error line source number
  * @retval None
  */
void assert_failed(uint8_t *file, uint32_t line)
{
  /* USER CODE BEGIN 6 */
  /* User can add his own implementation to report the file name and line number,
     tex: printf("Wrong parameters value: file %s on line %d\r\n", file, line) */
  /* USER CODE END 6 */
}
#endif /* USE_FULL_ASSERT */
